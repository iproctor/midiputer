## sdkconfig.defaults
```kconfig
# Enable USB external hub support (devices behind hub will enumerate)
CONFIG_USB_HOST_HUBS_SUPPORTED=y
CONFIG_USB_HOST_HUB_MULTI_LEVEL=y
CONFIG_USB_HOST_CONTROL_TRANSFER_MAX_SIZE=1024

# FreeRTOS tick rate for better timing resolution
CONFIG_FREERTOS_HZ=1000

# Adequate stack for main app task
CONFIG_ESP_MAIN_TASK_STACK_SIZE=16384

# Flash size 8MB
CONFIG_ESPTOOLPY_FLASHSIZE_8MB=y
CONFIG_ESPTOOLPY_FLASHSIZE="8MB"

# Log level
CONFIG_LOG_DEFAULT_LEVEL_INFO=y
CONFIG_LOG_DEFAULT_LEVEL=3
```
